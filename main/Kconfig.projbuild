## main/Kconfig.projbuild
```kconfig
menu "Reflect Configuration"

    config WIFI_NAME
        string "WiFi Name"
        default ""
        help
            Enter your Wifi network name

    config WIFI_PASSWORD
        string "WiFi Password"
        default ""
        help
            Enter your Wifi network password

    config OPENAI_API_KEY
        string "OpenAI API Key"
        default ""
        help
            Enter your OpenAI API Key

    config OPENAI_REALTIME_API_URL
        string "OpenAI Realtime API URL"
        default "https://api.openai.com/v1/realtime/calls?model=gpt-realtime"
        help
            Enter the OpenAI Realtime API Url


endmenu
```

## sdkconfig.defaults
```kconfig
CONFIG_IDF_TARGET="esp32s3"

CONFIG_SPIRAM=y

CONFIG_ESP_DEFAULT_CPU_FREQ_MHZ_240=y
CONFIG_FREERTOS_HZ=1000
CONFIG_COMPILER_OPTIMIZATION_PERF=y
CONFIG_COMPILER_OPTIMIZATION_ASSERTIONS_DISABLE=y
CONFIG_ESP_TASK_WDT_CHECK_IDLE_TASK_CPU0=n
CONFIG_ESP_TASK_WDT_CHECK_IDLE_TASK_CPU1=n

CONFIG_PARTITION_TABLE_CUSTOM=y

CONFIG_MBEDTLS_SSL_PROTO_DTLS=y

CONFIG_ESP_MAIN_TASK_STACK_SIZE=16384
```
